#! armcc -E --cpu Cortex-M4

#define CODE_BASE_ADDR_START    0x78000000
#define CODE_BASE_ADDR_END      0x7803FFF0
#define CODE_SIZE               (CODE_BASE_ADDR_END - CODE_BASE_ADDR_START)

#define DATA_BASE_ADDR_START    0x20000000
#define DATA_BASE_ADDR_END      0x20007FF0
#define DATA_SIZE               (DATA_BASE_ADDR_END - DATA_BASE_ADDR_START)

#define DATA_SHARED_START       0xBFF00000
#define DATA_SHARED_END         0xBFF0FFF0

#define DATA_CM_IRAM_START      0x2091F000
#define DATA_CM_IRAM_END        0x20920000

#define DATA_POOL_START         0x1FFF8010
#define DATA_POOL_END           0x1FFFFFF0

#define MY_ALIGN(address, alignment) ((address + (alignment-1)) AND ~(alignment-1))


LOAD_REGION_INTRAM CODE_BASE_ADDR_START
{
    VECTORS CODE_BASE_ADDR_START
    {
        vectors.o (.vectors_rom,+FIRST)
    }
    
    RAM_FUNC_AREA +0
    {
        * (RAM_FUNC)
    }
    
    RAM_FUNC_AREA_END +0
    {
        * (RAM_FUNC_END)
    }

    CODE +0
    {
        * (InRoot$$Sections)      ; All library sections for example, __main.o,
                                  ; __scatter*.o, __dc*.o, and * Region$$Table
        * (KERNEL)
        * (TEXT)
        * (+RO)
        * (ROM_END)
    }

    RAM_VECTORS DATA_BASE_ADDR_START ; For ram vector table. Used when  MQX_ROM_VECTORS is set to zero.
    {
        vectors.o (.vectors_ram)
    }
    
    DATA +0 ALIGN 32
    {
        * (+RW, +ZI)
    }

    KERNEL_DATA_START +0 ALIGN 16
    {
        * (KERNEL_DATA_START)
    }

    KERNEL_DATA_END (DATA_BASE_ADDR_END - 0x200)
    {
        * (KERNEL_DATA_END)
    }

    SHARED_RAM_START DATA_SHARED_START
    {
        * (SHARED_RAM_START)
    }

    SHARED_RAM_END DATA_SHARED_END
    {
        * (SHARED_RAM_END)
    }

    SHARED_CM_IRAM_START DATA_CM_IRAM_START
    {
        * (SHARED_CM_IRAM_START)
    }

    SHARED_CM_IRAM_END DATA_CM_IRAM_END
    {
        * (SHARED_CM_IRAM_END)
    }

    SRAM_POOL_START DATA_POOL_START
    {
        * (SRAM_POOL_START)
    }

    SRAM_POOL_END DATA_POOL_END
    {
        * (SRAM_POOL_END)
    }

    BOOT_STACK_ADDR (DATA_BASE_ADDR_END - 0x10) OVERLAY
    {
        * (BOOT_STACK)
    }

    ; We don't use their stack or heap, but the tools expect this
    ; to be here, so we have a dummy placeholder.
    ARM_LIB_STACKHEAP (DATA_BASE_ADDR_END - 0x4) OVERLAY EMPTY UNINIT 0x04 
    {
    }
}
